## config/west.yml
```yaml
manifest:
  remotes:
    - name: zmkfirmware
      url-base: https://github.com/zmkfirmware
    - name: Boettner-eric
      url-base: https://github.com/Boettner-eric/zmk-multi-module
  projects:
    - name: zmk
      remote: zmkfirmware
      revision: main
      import: app/west.yml
    - name: multi
      remote: Boettner-eric
      revision: main
  self:
    path: config
```
